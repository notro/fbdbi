## Kconfig
```kconfig
menuconfig FB_TFT
	tristate "Support for small TFT LCD display modules"
	depends on FB && SPI && GPIOLIB
	select FB_SYS_FILLRECT
	select FB_SYS_COPYAREA
	select FB_SYS_IMAGEBLIT
	select FB_SYS_FOPS
	select FB_DEFERRED_IO
	select FB_BACKLIGHT

config LCDREG
	default y if LCDREG_PAR
	tristate

config LCDREG_SPI
	tristate "LCD register for SPI bus"
	help
	  Choose this for LCD controllers using SPI

config LCDREG_PAR
	tristate "LCD register for parallel GPIO bus"
	help
	  Choose this for LCD controllers using a parallel databus
```
